## components/local_fabric/Kconfig
```kconfig
menu "Local Fabric"

    menu "Device manager"
        config FABRIC_MANAGER_MAX_DEVICES
            int "Maximum resolved devices"
            range 1 64
            default 16
    endmenu

    menu "Data model"
        config FABRIC_MANAGER_MAX_ENDPOINTS
            int "Maximum reported endpoints"
            range 1 128
            default 32

        config FABRIC_MANAGER_MAX_CLUSTERS_PER_ENDPOINT
            int "Maximum selected clusters per endpoint"
            range 1 32
            default 16
            help
                Bounds selected cluster adapters and the per-endpoint cluster mask.

        config FABRIC_MANAGER_MAX_DEVICE_TYPES_PER_ENDPOINT
            int "Maximum Matter device types per endpoint"
            range 1 16
            default 4
            help
                Bounds Descriptor DeviceTypeList entries retained per endpoint.
                Reports exceeding this limit are rejected atomically.

        config FABRIC_MANAGER_MAX_TAGS_PER_ENDPOINT
            int "Maximum Matter semantic tags per endpoint"
            range 1 16
            default 4
            help
                Bounds Descriptor TagList entries inspected for an endpoint name.
                Additional tags are ignored; tags never determine topology validity.

        config FABRIC_MANAGER_MAX_REPORT_RELATIONSHIPS
            int "Maximum Matter parent-child relationships per report"
            range 1 256
            default 64
            help
                Bounds Descriptor PartsList relationships retained in one atomic
                report transaction. Higher values increase transaction heap use.
    endmenu

    menu "Activity"
        config FABRIC_DEVICE_ACTIVITY_CAPACITY
            int "Number of recent device property changes to retain"
            range 8 128
            default 32
            help
                RAM only, shared by all devices. New entries overwrite the oldest.
                Independent of the automation trace pool.
    endmenu

    menu "Automation"
        config FABRIC_AUTOMATION
            bool "Enable local state-triggered automation"
            default n

        config FABRIC_AUTOMATION_ACTIVITY_CAPACITY
            int "Maximum finished automation traces"
            depends on FABRIC_AUTOMATION
            range 1 128
            default 32
            help
                Number of terminal run summaries in the PSRAM ring. When full, the next
                finished run replaces the oldest finished record.

        config FABRIC_AUTOMATION_TIMING
            bool "Log synchronized minute batch timings"
            depends on FABRIC_AUTOMATION
            default n
            help
                Report worker time and VM calls at minute boundaries, plus delay resumption time and deadline lateness.
    endmenu

endmenu
```

## examples/demo/main/Kconfig.projbuild
```kconfig
menu "Local fabric demo"
    config DEMO_SSID
        string "Wi-Fi SSID"
        default ""
    config DEMO_PASSWORD
        string "Wi-Fi password"
        default ""
    config DEMO_TIMEZONE
        string "Rule clock POSIX timezone"
        depends on FABRIC_AUTOMATION
        default "UTC0"
        help
            Board-local time for Lua conditions. Use a POSIX TZ string, not an IANA name.
    config DEMO_NTP_SERVER
        string "Rule clock NTP server"
        depends on FABRIC_AUTOMATION
        default "pool.ntp.org"
        help
            Use a LAN NTP server if the board cannot reach the public pool.
endmenu
```

## examples/demo/sdkconfig.defaults
```kconfig
CONFIG_IDF_TARGET="esp32s31"
CONFIG_IDF_EXPERIMENTAL_FEATURES=y
CONFIG_ESPTOOLPY_FLASHSIZE_16MB=y
CONFIG_PARTITION_TABLE_CUSTOM=y
CONFIG_PARTITION_TABLE_CUSTOM_FILENAME="partitions.csv"
CONFIG_SPIRAM=y
CONFIG_ENABLE_CHIP_CONTROLLER_BUILD=y
CONFIG_ESP_MATTER_CONTROLLER_ENABLE=y
CONFIG_ESP_MATTER_COMMISSIONER_ENABLE=y
CONFIG_ESP_MATTER_ENABLE_MATTER_SERVER=n
CONFIG_ESP_MATTER_ENABLE_OPENTHREAD=n
CONFIG_ENABLE_MATTER_OVER_THREAD=n
CONFIG_USE_MINIMAL_MDNS=y
CONFIG_TEST_ATTESTATION_TRUST_STORE=y
CONFIG_ESP_MATTER_COMMISSIONER_SUPPORT_TEST_CD=y
CONFIG_TEST_OPERATIONAL_CREDS_ISSUER=y
CONFIG_CHIP_TASK_STACK_SIZE=15360
CONFIG_ESP_MAIN_TASK_STACK_SIZE=10240
CONFIG_LWIP_IPV6_AUTOCONFIG=y
CONFIG_LWIP_IPV6_NUM_ADDRESSES=6
CONFIG_LWIP_MAX_SOCKETS=20
CONFIG_FABRIC_AUTOMATION=y
```
